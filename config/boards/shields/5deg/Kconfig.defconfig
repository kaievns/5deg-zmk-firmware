## config/boards/shields/5deg/Kconfig.defconfig
```kconfig
if SHIELD_5DEG_LEFT

config ZMK_KEYBOARD_NAME
	default "5deg"

config ZMK_SPLIT_ROLE_CENTRAL
	default y

config ZMK_USB
	default y

endif # SHIELD_5DEG_LEFT

if SHIELD_5DEG_LEFT || SHIELD_5DEG_RIGHT

config ZMK_SPLIT
	default y

config ZMK_BLE
	default y

endif # SHIELD_5DEG_LEFT || SHIELD_5DEG_RIGHT

if SHIELD_5DEG_RIGHT

config ZMK_SPLIT_BLE_PERIPHERAL_POSITION_QUEUE_SIZE
	default 32

endif # SHIELD_5DEG_RIGHT
```

## config/boards/shields/5deg/Kconfig.shield
```kconfig
config SHIELD_5DEG_LEFT
	def_bool $(shields_list_contains,5deg_left)

config SHIELD_5DEG_RIGHT
	def_bool $(shields_list_contains,5deg_right)
```

## modules/drivers/dts/bindings/pixart,pmw3610.yaml
```yaml
description: |
  PixArt PMW3610 ultra-low-power optical motion sensor (trackball).
  Uses 3-wire SPI (bidirectional SDIO) via GPIO bit-banging.

compatible: "pixart,pmw3610"

properties:
  cs-gpios:
    type: phandle-array
    required: true
    description: Chip select (NCS) GPIO, active low.

  clk-gpios:
    type: phandle-array
    required: true
    description: SPI clock GPIO.

  sdio-gpios:
    type: phandle-array
    required: true
    description: Bidirectional SPI data GPIO (SDIO).

  motion-gpios:
    type: phandle-array
    required: true
    description: Motion interrupt GPIO (active-low).

  cpi:
    type: int
    default: 800
    description: |
      Initial CPI (counts per inch), range 200-3200.
      Must be a multiple of 200.
```
